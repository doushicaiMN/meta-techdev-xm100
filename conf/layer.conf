## conf/layer.conf
```bitbake
# We have a conf and classes directory, add to BBPATH
BBPATH .= ":${LAYERDIR}"

# We have recipes-* directories, add to BBFILES
BBFILES += "${LAYERDIR}/recipes-*/*/*.bb \
            ${LAYERDIR}/recipes-*/*/*.bbappend"

BBFILE_COLLECTIONS += "meta-techdev-xm100"
BBFILE_PATTERN_meta-techdev-xm100 = "^${LAYERDIR}/"
BBFILE_PRIORITY_meta-techdev-xm100 = "6"

LAYERDEPENDS_meta-techdev-xm100 = "core"
LAYERSERIES_COMPAT_meta-techdev-xm100 = "gatesgarth"
```
